## boards/Innovaforce/nRF52833_tag/board.yml
```yaml
board:
  name: nRF52833_tag
  full_name: Innovaforce nRF52833 Tag
  vendor: Innovaforce
  socs:
    - name: nrf52833
```

## boards/Innovaforce/nRF52833_tag/nRF52833_tag_defconfig
```kconfig
CONFIG_ARM_MPU=y
CONFIG_HW_STACK_PROTECTION=y
CONFIG_GPIO=y
CONFIG_I2C=y
CONFIG_SPI=y
CONFIG_LED_STRIP=y
CONFIG_FUEL_GAUGE=y
CONFIG_BQ274XX=y
CONFIG_SERIAL=n
CONFIG_CONSOLE=n
CONFIG_UART_CONSOLE=n
CONFIG_LOG=n
CONFIG_WS2812_STRIP_SPI=y
```
